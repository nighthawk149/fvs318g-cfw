## linux-2.6.16-star/arch/arm/mach-str8100/Kconfig
```kconfig
if ARCH_STR8100

menu "STR8100 Options"

config CONSOLE_BAUD_RATE
	int "Console Baud Rate"
	default 38400
	help
	  set the console baudrate

config VIC_INTERRUPT
	bool "Enable Vector Interrupt Controller"
	default y
	help
	  enable the vector interrupt controller

choice
	prompt "DRAM SIZE"
	default STR8100_DRAM_16M

config STR8100_DRAM_16M
	bool "16MBytes"

config STR8100_DRAM_32M
	bool "32MBytes"

config STR8100_DRAM_64M
	bool "64MBytes"

endchoice

if PCI
choice
	prompt "PCI Frequency"
	default STR8100_PCI33M

config STR8100_PCI33M
	bool "PCI_33Mhz"

config STR8100_PCI66M
	bool "PCI_66Mhz"

endchoice
endif

config STR8100_DMA
	bool "Enable DMA Controller"
	default n
	help
	  enable the DMA controller

config STR8100_HSDMA
	bool "Enable HSDMA Controller"
	default n
	help
	  enable the HSDMA controller

config STR8100_INFO
	bool "STR8100 Infomation at /proc/str8100/info"

config STR8100_USBD_REBOOT_INTHANDLER
	tristate "USB Mass Storage Device"

config STR8100_I2S_DEMO
	tristate "Enable I2S sound demo driver"
	default n
	help
	  enable the I2S sound demo driver with /proc/str8100/i2s

config STR8100_I2S_WM8772_DEMO
	tristate "Enable I2S sound demo driver with WM8772"
	default n
	help
	  enable the I2S sound demo driver with wm8772

config LE88221_CONTROL
	bool "Legerity LE88221 Control Support"
	depends on SPI

config STR8100_PCM_LEGERITY_2PHONE_DEMO
	tristate "2 phone PCM sound demo driver for Legerity"
	select LE88221_CONTROL
	default n

comment "Flash MAP"
config STR8100_FLASH_PART
	bool "STR8100 flash partition setting"

if STR8100_FLASH_PART
	config ARMBOOT_OFFSET
	hex "ARMBOOT OFFSET"
	default 0x0
	help
	  The armboot start offset in flash layout

	config KERNEL_OFFSET
	hex "KERNEL OFFSET"
	default 0x40000
	help
	  The kernel start offset in flash layout

	config ROOTFS_OFFSET
	hex "ROOTFS OFFSET"
	default 0x140000
	help
	  The rootfs start offset in flash layout

	config CFG_OFFSET
	hex "CFG OFFSET"
	default 0x7f0000
	help
	  The cfg start offset in flash layout
endif


comment "Third Party Support"

config STR8100_EWC_SUPPORT
	bool "EWC(802.11N) Support"

endmenu

endif
```

## linux-2.6.16-star/arch/arm/mach-str9100/Kconfig
```kconfig
if ARCH_STR9100

menu "STR9100 Options"

config CONSOLE_BAUD_RATE
	int "Console Baud Rate"
	default 115200
	help
	  set the console baudrate

config CPU_ISPAD_ENABLE
	bool "Enable I-Scratch Pad Support"
	default y
	help
	  enable I-Scratch Pad support

config CPU_DSPAD_ENABLE
	bool "Enable D-Scratch Pad Support"
	default n
	help
	  enable D-Scratch Pad support (Cannot Work Now)

choice
	prompt "DRAM SIZE"
	default STR9100_DRAM_16M

config STR9100_DRAM_16M
	bool "16MBytes"

config STR9100_DRAM_32M
	bool "32MBytes"

config STR9100_DRAM_64M
	bool "64MBytes"

endchoice


choice
	prompt "Counter Mode"
	default STR9100_TIMER_COUNTER
	help 
	    STR9100 BSP will use timer2 for counter mode. 
	    COUNTER will provide a general API for timer counter
	    INTERRUPT will use timer interrupt for timer counter

config STR9100_TIMER_COUNTER
	bool "COUNTER"

config STR9100_TIMER_INTERRUPT
	bool "INTERRUPT"

endchoice


if PCI
choice
	prompt "PCI Frequency"
	default STAR9100_PCI33M

config STR9100_PCI33M
	bool "PCI_33Mhz"

config STR9100_PCI66M
	bool "PCI_66Mhz"

endchoice
endif

config STR9100_INFO
	bool "STR9100 Infomation at /proc/str9100/info"

comment "Flash MAP"
config STR9100_FLASH_PART
	bool "STR9100 flash partition setting"

if STR9100_FLASH_PART
	config ARMBOOT_OFFSET
	hex "ARMBOOT OFFSET"
	default 0x0
	help
	  The armboot start offset in flash layout

	config KERNEL_OFFSET
	hex "KERNEL OFFSET"
	default 0x40000
	help
	  The kernel start offset in flash layout

	config ROOTFS_OFFSET
	hex "ROOTFS OFFSET"
	default 0x140000
	help
	  The rootfs start offset in flash layout

	config CFG_OFFSET
	hex "CFG OFFSET"
	default 0x7f0000
	help
	  The cfg start offset in flash layout
endif

comment "Third Party Support"

config STR9100_EWC_SUPPORT
	bool "EWC(802.11N) Support"

config SWITCH_IOCTL
	bool "SUPPORT SWITCH IOCTL"

endmenu

endif
```

## linux-2.6.16-star/drivers/net/str8100/Kconfig
```kconfig
menu "STAR Equuleus NIC support"
	depends on ARCH_STR8100

config STAR_NIC
	tristate "STAR Equuleus NIC driver support"
	help

choice 
	depends on STAR_NIC 
        prompt "PHY Driver"
        default STR_NIC_PHY_VSC8201
          
config STAR_NIC_PHY_INTERNAL_PHY
        bool "Star Internal 10/100 PHY"

config STAR_NIC_PHY_VSC8601
        bool "Vitesse 8601"
        
config STAR_NIC_PHY_IP101A
        bool "ICPlus IP101A"

config STAR_NIC_PHY_IP1001
        bool "ICPlus IP1001"
          
endchoice

endmenu
```

## linux-2.6.16-star/drivers/net/str9100.26/Kconfig
```kconfig
menu "STAR Gigabit Switch support"
	depends on ARCH_STR9100

config STAR_GSW
	tristate "STAR Gigabit Switch driver support"
	help

choice
	prompt "STAR Board"
	depends on STAR_GSW
	default DORADO

config DORADO
	bool "Dorado"

config DORADO2
	bool "Dorado2"

config VIRGO
	bool "Virgo"

config VELA
	bool "Vela"

config LIBRA
	bool "Libra"

config LEO
	bool "Leo"

endchoice

config STR9100_SHNAT
	bool "STAR Smart HNAT Support"
	depends on STAR_GSW
	help
	  Add STAR Smart HNAT support function in kernel

endmenu
```

## linux-2.6.16-star/drivers/net/str9100/Kconfig
```kconfig
menu "STAR Gigabit Switch support"
	depends on ARCH_STR9100

config STAR_GSW
	tristate "STAR Gigabit Switch driver support"

choice
	prompt "STAR Board"
	depends on STAR_GSW
	default DORADO

config DORADO
	bool "Dorado"

config DORADO2
	bool "Dorado2"

config VIRGO
	bool "Virgo"

config VELA
	bool "Vela"

config LIBRA
	bool "Libra"
	help
		Board configuration Libra(one arm mode):
			Cooperate with IC+175C - 5 port 10/100 ethernet integrated switch.
			Configure as two VLANs, one for WAN and another for LAN. Tag base 
			VLAN transfer with VLAN tag. The IC+175C connects to MAC0 only.

config LIBRA2
	bool "Libra2"
	help
		Board configuration Libra2(two arm mode):
			Cooperate with IC+175C - 5 port 10/100 ethernet integrated switch.
			Port based VLAN transfer without VLAN tag. The IC+175C PHY0~PHY3
			connects to MAC0, PHY4 connects to MAC1.

config LEO
	bool "Leo"

endchoice

config STR9100_SHNAT
	bool "STAR Smart HNAT Support"
	depends on STAR_GSW
	help
	  Add STAR Smart HNAT support function in kernel

config STAR9100_SHNAT_PCI_FASTPATH
	bool "   FastPath(From PCI to WAN) Support"
	depends on STR9100_SHNAT
	help
      Add FastPath Support for Smart HNAT.

config STAR9100_SHNAT_BRIDGE_QOS
	bool "   SHNAT QoS Support (Bridge)"
	depends on STR9100_SHNAT && STAR9100_SHNAT_PCI_FASTPATH
	default n
	help
      Add Smart HNAT QoS support in bridge mode.

config STAR_NIC_PARAM_FROM_MTD
	bool "Read required parameter from flash"
	default n
	
config STAR_NIC_PARAM_MTD_DEVNUM
	int "MTD env devnum"
	depends on STAR_NIC_PARAM_FROM_MTD
	default 1

config STAR_NIC_PARAM_MTD_OFFSET
	hex "MTD env offset"
	depends on STAR_NIC_PARAM_FROM_MTD
	default 0x20000

config STAR_NIC_PARAM_MTD_SIZE
	hex "MTD env size"
	depends on STAR_NIC_PARAM_FROM_MTD
	default 0x10000

config STAR_NIC_PARAM_MAC_KEYWORD
	string "MTD env entry keyword"
	depends on STAR_NIC_PARAM_FROM_MTD
	default "ethaddr="

config STAR_NIC_PARAM_MAC_VALUE_END
	hex "MTD env entry end character in hex"
	depends on STAR_NIC_PARAM_FROM_MTD
	default "0x0"
endmenu
```

## linux-2.6.16-star/net/bridge/Kconfig
```kconfig
#
# 802.1d Ethernet Bridging
#

config BRIDGE
	tristate "802.1d Ethernet Bridging"
	---help---
	  If you say Y here, then your Linux box will be able to act as an
	  Ethernet bridge, which means that the different Ethernet segments it
	  is connected to will appear as one Ethernet to the participants.
	  Several such bridges can work together to create even larger
	  networks of Ethernets using the IEEE 802.1 spanning tree algorithm.
	  As this is a standard, Linux bridges will cooperate properly with
	  other third party bridge products.

	  In order to use the Ethernet bridge, you'll need the bridge
	  configuration tools; see <file:Documentation/networking/bridge.txt>
	  for location. Please read the Bridge mini-HOWTO for more
	  information.

	  If you enable iptables support along with the bridge support then you
	  turn your bridge into a bridging IP firewall.
	  iptables will then see the IP packets being bridged, so you need to
	  take this into account when setting up your firewall rules.
	  Enabling arptables support when bridging will let arptables see
	  bridged ARP traffic in the arptables FORWARD chain.

	  To compile this code as a module, choose M here: the module
	  will be called bridge.

	  If unsure, say N.

if BRIDGE
config BRIDGE_ID_POLICY_MINIMUM
	bool " Bridge ID select policy - minimum"
	default n
	help
	  The policy to choose bridge ID. If you say Y, the bridge would choose 
	  the minimum bridge port ID as it's ID. This feature will affect PCI 
	  fastpath function of Star's STR9100 series.
	  
endif
```
